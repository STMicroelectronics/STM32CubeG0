# file: CEC_ListenMode_Device_1.ioc
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HDMI_CEC.BREErrorBitGen=CEC_BRE_ERRORBIT_NO_GENERATION
HDMI_CEC.BRERxStop=CEC_NO_RX_STOP_ON_BRE
HDMI_CEC.BroadcastMsgNoErrorBitGen=CEC_BROADCASTERROR_NO_ERRORBIT_GENERATION
HDMI_CEC.LBPEErrorBitGen=CEC_LBPE_ERRORBIT_NO_GENERATION
HDMI_CEC.ListenMode=CEC_REDUCED_LISTENING_MODE
HDMI_CEC.OwnAddress0=CEC_OWN_ADDRESS_NONE
HDMI_CEC.OwnAddress1=CEC_OWN_ADDRESS_1
HDMI_CEC.OwnAddress10=CEC_OWN_ADDRESS_NONE
HDMI_CEC.OwnAddress11=CEC_OWN_ADDRESS_NONE
HDMI_CEC.OwnAddress12=CEC_OWN_ADDRESS_NONE
HDMI_CEC.OwnAddress13=CEC_OWN_ADDRESS_NONE
HDMI_CEC.OwnAddress14=CEC_OWN_ADDRESS_NONE
HDMI_CEC.OwnAddress2=CEC_OWN_ADDRESS_NONE
HDMI_CEC.OwnAddress3=CEC_OWN_ADDRESS_NONE
HDMI_CEC.OwnAddress4=CEC_OWN_ADDRESS_NONE
HDMI_CEC.OwnAddress5=CEC_OWN_ADDRESS_NONE
HDMI_CEC.OwnAddress6=CEC_OWN_ADDRESS_NONE
HDMI_CEC.OwnAddress7=CEC_OWN_ADDRESS_NONE
HDMI_CEC.OwnAddress8=CEC_OWN_ADDRESS_NONE
HDMI_CEC.OwnAddress9=CEC_OWN_ADDRESS_NONE
HDMI_CEC.RxBuffer=Tab_Rx
HDMI_CEC.SignalFreeTime=CEC_DEFAULT_SFT
HDMI_CEC.SignalFreeTimeOption=CEC_SFT_START_ON_TXSOM
HDMI_CEC.Tolerance=CEC_STANDARD_TOLERANCE
Mcu.Family=STM32G0
Mcu.Name=STM32G081RBTx
Mcu.Package=LQFP64
NVIC.CEC_IRQn=true\:0\:0\:false\:false\:true\:true\:true\:true
PB10.GPIO_Speed=GPIO_SPEED_FREQ_HIGH
PB10.Mode=CEC_Activate
PB10.Signal=CEC
ProjectManager.HeapSize=0x200
ProjectManager.StackSize=0x400
ProjectManager.TargetToolchain=EWARM V8.50
RCC.ADCFreq_Value=56000000
RCC.AHBFreq_Value=56000000
RCC.CodegenConfigPeriph=false
RCC.CortexFreq_Value=56000000
RCC.EXTERNAL_CLOCK_VALUE=12288000
RCC.HCLKFreq_Value=56000000
RCC.HSE_VALUE=8000000
RCC.HSI_VALUE=16000000
RCC.LSE_VALUE=32768
RCC.PLLM=RCC_PLLM_DIV4
RCC.PLLN=70
RCC.PLLP=RCC_PLLP_DIV10
RCC.PLLQ=RCC_PLLQ_DIV5
RCC.PLLR=RCC_PLLR_DIV5
RCC.SYSCLKFreq_VALUE=56000000
RCC.SYSCLKSource=RCC_SYSCLKSOURCE_PLLCLK
RCC.VCOOutputFreq_Value=280000000
VP_SYS_VS_DBSignals.Mode=DisableDeadBatterySignals
board=custom

// file: Src/main.c
/* USER CODE BEGIN Header */
/**
  ******************************************************************************
  * @file    CEC/CEC_ListenMode_Device_1/Src/main.c
  * @author  MCD Application Team
  * @brief   This example describes how to configure and use the CEC through
  *          the STM32G0xx HAL API.
  ******************************************************************************
  * @attention
  *
  * Copyright (c) 2018-2020 STMicroelectronics.
  * All rights reserved.
  *
  * This software is licensed under terms that can be found in the LICENSE file
  * in the root directory of this software component.
  * If no LICENSE file comes with this software, it is provided AS-IS.
  *
  ******************************************************************************
  */
/* USER CODE END Header */
#include "main.h"

CEC_HandleTypeDef hcec;

   uint8_t Tab_Rx[16];
/* USER CODE BEGIN PV */
uint8_t  Tab_Tx[CEC_MAX_PAYLOAD-1]; /* Transmitted data buffer.
                                     * header is not included in Tab_Tx.
                                     *  Max size = 15 bytes.
                                     *  one opcode followed by up to 14 operands.
                                     *  When payload size = 0, only the header is sent
                                     *  (ping operation) */
uint8_t ReceivedFrame       = 0x0;  /* Set when a reception occurs */
uint16_t NbOfReceivedBytes  = 0x0;  /* Number of received bytes in addition to the header.
                                     * when a ping message has been received (header
                                     * only), NbOfReceivedBytes = 0 */
uint8_t StartSending        = 0x0;  /* Set when a transmission is triggered by the user */
uint32_t TxSize             = 0x0;  /* Number of bytes to transmit in addition to the header.
                                     * In case of ping operation (only the header sent),
                                     * TxSize = 0 */
uint8_t DestinationAddress = 0;     /* Destination logical address */
uint8_t InitiatorAddress = 0;       /* Initiator logical address */
__IO uint8_t TxStatus = 0;
/* USER CODE END PV */

void SystemClock_Config(void);
static void MX_GPIO_Init(void);
static void MX_HDMI_CEC_Init(void);
/* USER CODE BEGIN PFP */
static void CEC_FlushRxBuffer(void);
/* USER CODE END PFP */

int main(void)
{
  /* USER CODE BEGIN 1 */
  /* STM32G0xx HAL library initialization:
       - Configure the Flash prefetch
       - Systick timer is configured by default as source of time base, but user
         can eventually implement his proper time base source (a general purpose
         timer for example or other time source), keeping in mind that Time base
         duration should be kept 1ms since PPP_TIMEOUT_VALUEs are defined and
         handled in milliseconds basis.
       - Low Level Initialization
     */
  /* USER CODE END 1 */

  /* MCU Configuration--------------------------------------------------------*/

  /* Reset of all peripherals, Initializes the Flash interface and the Systick. */
  HAL_Init();

  /* Configure the system clock */
  SystemClock_Config();

  /* Initialize all configured peripherals */
  MX_GPIO_Init();
  MX_HDMI_CEC_Init();
  /* USER CODE BEGIN 2 */
  /* -1- Initialize LEDs mounted on EVAL board */
  /* Configure LED1, LED2, LED3 and LED4 */
  BSP_LED_Init(LED1);
  BSP_LED_Init(LED2);
  BSP_LED_Init(LED3);
  BSP_LED_Init(LED4);

  /* -2- Configure Tamper push-button in Interrupt mode */
  /* button-triggered interruptions initialization */
  BSP_PB_Init(BUTTON_TAMPER,BUTTON_MODE_EXTI);

  /* -3- Configure Joystick Selection push-button in Interrupt mode */
  BSP_JOY_Init(JOY_MODE_EXTI);

  /* CEC device initialization */

  DestinationAddress = 0x3; /* follower address */
  InitiatorAddress = 0x1;

  /* -4- CEC transfer general variables initialization */
  ReceivedFrame = 0;
  StartSending = 0;
  NbOfReceivedBytes = 0;
  CEC_FlushRxBuffer();

  /* USER CODE END 2 */

  /* Infinite loop */
  /* USER CODE BEGIN WHILE */
  while (1)
  {
    /* if no reception has occurred and no error has been detected,
     * transmit a message if the user has pushed a button */
     while( (StartSending == 1) && (ReceivedFrame == 0))
    {
      HAL_CEC_Transmit_IT(&hcec,InitiatorAddress ,DestinationAddress, (uint8_t *)&Tab_Tx, TxSize);
      /* loop until TX ends or TX error reported */
        while (TxStatus != 1);
      StartSending = 0;
      TxStatus = 0;
    }

    /* if a frame has been received */
    if (ReceivedFrame == 1)
    {
      if (Tab_Rx[1] == 0x44) /* Test on the opcode value */
      {
        /* Receive command is equal to Volume Up(Button Up) */
        if (Tab_Rx[2] == 0x41) /* Test on the operand value */
        {
          BSP_LED_On(LED1);
          BSP_LED_On(LED2);
          BSP_LED_On(LED3);
          BSP_LED_On(LED4);
        }
        else if (Tab_Rx[2] == 0x42) /* Receive command is equal to Volume Down(Button Down) */
        {
          BSP_LED_Off(LED1);
          BSP_LED_Off(LED2);
          BSP_LED_Off(LED3);
          BSP_LED_Off(LED4);
        }
      }
      else if (Tab_Rx[1] == 0x46) /* Test on the opcode value */
      {
        BSP_LED_On(LED1);
        BSP_LED_On(LED2);
        BSP_LED_Off(LED3);
        BSP_LED_Off(LED4);
      }
      else if (Tab_Rx[1] == 0x9F) /* Test on the opcode value */
      {
        BSP_LED_Off(LED1);
        BSP_LED_Off(LED2);
        BSP_LED_On(LED3);
        BSP_LED_On(LED4);
      }
      ReceivedFrame = 0;
      CEC_FlushRxBuffer();
    }
    else if (ReceivedFrame == 2) /* means CEC error detected */
    {
      /* Turn on LED3 */
      BSP_LED_On(LED3);
      ReceivedFrame = 0;
    }

    /* USER CODE END WHILE */

  }
}

void SystemClock_Config(void)
{
  RCC_OscInitTypeDef RCC_OscInitStruct = {0};
  RCC_ClkInitTypeDef RCC_ClkInitStruct = {0};

  /** Configure the main internal regulator output voltage
  */
  HAL_PWREx_ControlVoltageScaling(PWR_REGULATOR_VOLTAGE_SCALE1);

  /** Initializes the RCC Oscillators according to the specified parameters
  * in the RCC_OscInitTypeDef structure.
  */
  RCC_OscInitStruct.OscillatorType = RCC_OSCILLATORTYPE_HSI;
  RCC_OscInitStruct.HSIState = RCC_HSI_ON;
  RCC_OscInitStruct.HSIDiv = RCC_HSI_DIV1;
  RCC_OscInitStruct.HSICalibrationValue = RCC_HSICALIBRATION_DEFAULT;
  RCC_OscInitStruct.PLL.PLLState = RCC_PLL_ON;
  RCC_OscInitStruct.PLL.PLLSource = RCC_PLLSOURCE_HSI;
  RCC_OscInitStruct.PLL.PLLM = RCC_PLLM_DIV4;
  RCC_OscInitStruct.PLL.PLLN = 70;
  RCC_OscInitStruct.PLL.PLLP = RCC_PLLP_DIV10;
  RCC_OscInitStruct.PLL.PLLQ = RCC_PLLQ_DIV5;
  RCC_OscInitStruct.PLL.PLLR = RCC_PLLR_DIV5;
  if (HAL_RCC_OscConfig(&RCC_OscInitStruct) != HAL_OK)
  {
    Error_Handler();
  }

  /** Initializes the CPU, AHB and APB buses clocks
  */
  RCC_ClkInitStruct.ClockType = RCC_CLOCKTYPE_HCLK|RCC_CLOCKTYPE_SYSCLK
                              |RCC_CLOCKTYPE_PCLK1;
  RCC_ClkInitStruct.SYSCLKSource = RCC_SYSCLKSOURCE_PLLCLK;
  RCC_ClkInitStruct.AHBCLKDivider = RCC_SYSCLK_DIV1;
  RCC_ClkInitStruct.APB1CLKDivider = RCC_HCLK_DIV1;

  if (HAL_RCC_ClockConfig(&RCC_ClkInitStruct, FLASH_LATENCY_2) != HAL_OK)
  {
    Error_Handler();
  }
}

static void MX_HDMI_CEC_Init(void)
{

  hcec.Instance = CEC;
  hcec.Init.SignalFreeTime = CEC_DEFAULT_SFT;
  hcec.Init.Tolerance = CEC_STANDARD_TOLERANCE;
  hcec.Init.BRERxStop = CEC_NO_RX_STOP_ON_BRE;
  hcec.Init.BREErrorBitGen = CEC_BRE_ERRORBIT_NO_GENERATION;
  hcec.Init.LBPEErrorBitGen = CEC_LBPE_ERRORBIT_NO_GENERATION;
  hcec.Init.BroadcastMsgNoErrorBitGen = CEC_BROADCASTERROR_NO_ERRORBIT_GENERATION;
  hcec.Init.SignalFreeTimeOption = CEC_SFT_START_ON_TXSOM;
  hcec.Init.ListenMode = CEC_REDUCED_LISTENING_MODE;
  hcec.Init.OwnAddress = CEC_OWN_ADDRESS_1;
  hcec.Init.RxBuffer = Tab_Rx;
  if (HAL_CEC_Init(&hcec) != HAL_OK)
  {
    Error_Handler();
  }

}

static void MX_GPIO_Init(void)
{

  /* GPIO Ports Clock Enable */
  __HAL_RCC_GPIOB_CLK_ENABLE();

}

/* USER CODE BEGIN 4 */

/**
  * @brief Tx Transfer completed callback
  * @param hcec: CEC handle
  * @retval None
  */
void HAL_CEC_TxCpltCallback(CEC_HandleTypeDef *hcec)
{
  /* End of transmission */
  TxStatus =1;
}

/**
  * @brief Rx Transfer completed callback
  * @param hcec: CEC handle
  * @retval None
  */
void HAL_CEC_RxCpltCallback(CEC_HandleTypeDef *hcec, uint32_t RxFrameSize)
{
  ReceivedFrame = 1;
}

/**
  * @brief CEC error callbacks
  * @param hcec: CEC handle
  * @retval None
  */
void HAL_CEC_ErrorCallback(CEC_HandleTypeDef *hcec)
{
  ReceivedFrame = 2;
}

/**
  * @brief  Reset CEC reception buffer
  * @param  None
  * @retval None
  */
static void CEC_FlushRxBuffer(void)
{
  uint32_t cpt;

  for (cpt = CEC_MAX_PAYLOAD; cpt > 0; cpt--)
  {
    Tab_Rx[cpt-1] = 0;
  }
}

/**
  * @brief EXTI line Falling detection callbacks
  * @param GPIO_Pin: Specifies the pins connected EXTI line
  * @retval None
  */
void HAL_GPIO_EXTI_Falling_Callback(uint16_t GPIO_Pin)
{

  if(GPIO_Pin == TAMPER_BUTTON_PIN)
  {
    /* Toggle GREEN LED1 */
    BSP_LED_Toggle(LED1);

    Tab_Tx[0] = 0x44;
    Tab_Tx[1] = 0x42;
    TxSize    = 0x02;
    StartSending = 1;
  }
}

/**
  * @brief EXTI line Rising detection callbacks
  * @param GPIO_Pin: Specifies the pins connected EXTI line
  * @retval None
  */
void HAL_GPIO_EXTI_Rising_Callback(uint16_t GPIO_Pin)
{
  if(GPIO_Pin == DOWN_JOY_PIN)
  {
    /* Toggle BLUE LED4 */
    BSP_LED_Toggle(LED4);

    Tab_Tx[0] = 0x9F;
    TxSize    = 0x01;
    StartSending = 1;
  }
  if(GPIO_Pin == SEL_JOY_PIN)
  {
    /* Toggle ORANGE LED2 */
    BSP_LED_Toggle(LED2);

    Tab_Tx[0] = 0x46;
    TxSize    = 0x01;
    StartSending = 1;
  }

  if(GPIO_Pin == UP_JOY_PIN)
  {
    /* Toggle RED LED3 */
    BSP_LED_Toggle(LED3);

    Tab_Tx[0] = 0x44;
    Tab_Tx[1] = 0x41;
    TxSize    = 0x02;
    StartSending = 1;
  }
}

/* USER CODE END 4 */

void Error_Handler(void)
{
  /* USER CODE BEGIN Error_Handler_Debug */
  /* User can add his own implementation to report the HAL error return state */
  /* Turn LED3 on */
  BSP_LED_On(LED3);

  while(1)
  {
  }
  /* USER CODE END Error_Handler_Debug */
}
