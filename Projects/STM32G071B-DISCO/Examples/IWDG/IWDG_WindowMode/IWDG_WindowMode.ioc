# file: IWDG_WindowMode.ioc
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IWDG.Prescaler=IWDG_PRESCALER_16
IWDG.Reload=IWDG_RELOAD
IWDG.Window=IWDG_WINDOW
Mcu.Family=STM32G0
Mcu.Name=STM32G071R(6-8-B)Tx
Mcu.Package=LQFP64
ProjectManager.HeapSize=0x200
ProjectManager.StackSize=0x400
ProjectManager.TargetToolchain=EWARM V8.50
RCC.ADCFreq_Value=64000000
RCC.AHBFreq_Value=64000000
RCC.CodegenConfigPeriph=false
RCC.CortexFreq_Value=64000000
RCC.EXTERNAL_CLOCK_VALUE=12288000
RCC.HCLKFreq_Value=64000000
RCC.HSE_VALUE=8000000
RCC.HSI_VALUE=16000000
RCC.LSE_VALUE=32768
RCC.PLLP=RCC_PLLP_DIV4
RCC.SYSCLKFreq_VALUE=64000000
RCC.SYSCLKSource=RCC_SYSCLKSOURCE_PLLCLK
RCC.VCOOutputFreq_Value=128000000
VP_IWDG_VS_IWDG.Mode=IWDG_Activate
VP_SYS_VS_DBSignals.Mode=DisableDeadBatterySignals
board=custom

// file: Src/main.c
/* USER CODE BEGIN Header */
/**
  ******************************************************************************
  * @file    IWDG/IWDG_WindowMode/Src/main.c
  * @author  MCD Application Team
  * @brief   This sample code shows how to use the STM32G071xx IWDG HAL API
  *          to update at regular period the IWDG counter and how to simulate a
  *          software fault generating an MCU IWDG reset on expiry of a
  *          programmed time period.
  ******************************************************************************
  * @attention
  *
  * Copyright (c) 2019-2020 STMicroelectronics.
  * All rights reserved.
  *
  * This software is licensed under terms that can be found in the LICENSE file
  * in the root directory of this software component.
  * If no LICENSE file comes with this software, it is provided AS-IS.
  *
  ******************************************************************************
  */
/* USER CODE END Header */
#include "main.h"

/* USER CODE BEGIN PD */
#define IWDG_WINDOW (32000 * 400) / (16 * 1000)  /* 400 ms */
#define IWDG_RELOAD (32000 * 762) / (16 * 1000)  /* 762 ms */
/* USER CODE END PD */

IWDG_HandleTypeDef hiwdg;

/* USER CODE BEGIN PV */
uint32_t IwdgStatus = 0;

/* In while loop, time to wait before refresh */
uint32_t WaitingDelay = 0;

/* USER CODE END PV */

void SystemClock_Config(void);
static void MX_IWDG_Init(void);

int main(void)
{

  /* MCU Configuration--------------------------------------------------------*/

  /* Reset of all peripherals, Initializes the Flash interface and the Systick. */
  HAL_Init();

  /* Configure the system clock */
  SystemClock_Config();

  /* USER CODE BEGIN SysInit */
  /* Configure LED6 and LED4 */
  BSP_LED_Init(LED6);
  BSP_LED_Init(LED4);

  /*##-1- Check if the system has resumed from IWDG reset ####################*/
  if (__HAL_RCC_GET_FLAG(RCC_FLAG_IWDGRST) != 0x00u)
  {
    /* IWDGRST flag set: Turn LED6 on and set IwdgStatus */
    IwdgStatus = 1;
    BSP_LED_On(LED6);

    /* Insert 4s delay */
    HAL_Delay(4000);

    /* Prior to clear IWDGRST flag: Turn LED6 off */
    BSP_LED_Off(LED6);
  }

  /* Clear reset flags anyway */
  __HAL_RCC_CLEAR_RESET_FLAGS();
  IwdgStatus = 0;
  /* USER CODE END SysInit */

  /* Initialize all configured peripherals */
  MX_IWDG_Init();
  /* USER CODE BEGIN 2 */

/* Configure Joystick Selection push-button */
  BSP_JOY_Init(JOY_MODE_EXTI);

  /* Initial delay will be 450 ms in order to be inside the window */
  WaitingDelay = 450;

  /* USER CODE END 2 */

  /* Infinite loop */
  while (1)
  {

    /* USER CODE BEGIN 3 */
    /* Toggle LED6 */
    BSP_LED_Toggle(LED6);

    HAL_Delay(WaitingDelay);

    /* Refresh IWDG: reload counter */
    if(HAL_IWDG_Refresh(&hiwdg) != HAL_OK)
    {
      /* Refresh Error */
      Error_Handler();
    }
  }
  /* USER CODE END 3 */
}

void SystemClock_Config(void)
{
  RCC_OscInitTypeDef RCC_OscInitStruct = {0};
  RCC_ClkInitTypeDef RCC_ClkInitStruct = {0};

  /** Configure the main internal regulator output voltage
  */
  HAL_PWREx_ControlVoltageScaling(PWR_REGULATOR_VOLTAGE_SCALE1);

  /** Initializes the RCC Oscillators according to the specified parameters
  * in the RCC_OscInitTypeDef structure.
  */
  RCC_OscInitStruct.OscillatorType = RCC_OSCILLATORTYPE_HSI;
  RCC_OscInitStruct.HSIState = RCC_HSI_ON;
  RCC_OscInitStruct.HSIDiv = RCC_HSI_DIV1;
  RCC_OscInitStruct.HSICalibrationValue = RCC_HSICALIBRATION_DEFAULT;
  RCC_OscInitStruct.PLL.PLLState = RCC_PLL_ON;
  RCC_OscInitStruct.PLL.PLLSource = RCC_PLLSOURCE_HSI;
  RCC_OscInitStruct.PLL.PLLM = RCC_PLLM_DIV1;
  RCC_OscInitStruct.PLL.PLLN = 8;
  RCC_OscInitStruct.PLL.PLLP = RCC_PLLP_DIV4;
  RCC_OscInitStruct.PLL.PLLQ = RCC_PLLQ_DIV2;
  RCC_OscInitStruct.PLL.PLLR = RCC_PLLR_DIV2;
  if (HAL_RCC_OscConfig(&RCC_OscInitStruct) != HAL_OK)
  {
    Error_Handler();
  }

  /** Initializes the CPU, AHB and APB buses clocks
  */
  RCC_ClkInitStruct.ClockType = RCC_CLOCKTYPE_HCLK|RCC_CLOCKTYPE_SYSCLK
                              |RCC_CLOCKTYPE_PCLK1;
  RCC_ClkInitStruct.SYSCLKSource = RCC_SYSCLKSOURCE_PLLCLK;
  RCC_ClkInitStruct.AHBCLKDivider = RCC_SYSCLK_DIV1;
  RCC_ClkInitStruct.APB1CLKDivider = RCC_HCLK_DIV1;

  if (HAL_RCC_ClockConfig(&RCC_ClkInitStruct, FLASH_LATENCY_2) != HAL_OK)
  {
    Error_Handler();
  }
}

static void MX_IWDG_Init(void)
{

  hiwdg.Instance = IWDG;
  hiwdg.Init.Prescaler = IWDG_PRESCALER_16;
  hiwdg.Init.Window = IWDG_WINDOW;
  hiwdg.Init.Reload = IWDG_RELOAD;
  if (HAL_IWDG_Init(&hiwdg) != HAL_OK)
  {
    Error_Handler();
  }

}

/* USER CODE BEGIN 4 */

/**
  * @brief  EXTI line detection callback to decrease waiting delay. That will make
            refresh being outside window value.
  * @param  GPIO_Pin: Specifies the port pin connected to corresponding EXTI line.
  * @retval None
  */
void HAL_GPIO_EXTI_Rising_Callback(uint16_t GPIO_Pin)
{
  if(GPIO_Pin == SEL_JOY_PIN)
  {
    /* waiting 200 ms to be above window value on next refresh */
    WaitingDelay = 200;
  }
}

/* USER CODE END 4 */

void Error_Handler(void)
{
  /* USER CODE BEGIN Error_Handler_Debug */
  /* Turn LED4 on */
  BSP_LED_On(LED4);

  IwdgStatus = 0xE;
  /* Infinite loop */
  while(1)
  {
  }
  /* USER CODE END Error_Handler_Debug */
}
